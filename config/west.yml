## config/west.yml
```yaml
manifest:
  remotes:
    - name: zmkfirmware
      url-base: https://github.com/zmkfirmware
  projects:
    - name: zmk
      remote: zmkfirmware
      revision: edf5c0814fd3ea202e43aad2d68fd32e882a518c  # v0.3.0 (tag v0.3 resolves to the same commit)
      import: app/west.yml
  self:
    path: config
```
